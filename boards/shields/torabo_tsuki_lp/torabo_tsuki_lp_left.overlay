#include "torabo_tsuki_lp.dtsi"
#include <input/processors.dtsi>
#include <dt-bindings/zmk/input_transform.h>

&pointing_listener {
    input-processors = <&zip_xy_transform (INPUT_TRANSFORM_X_INVERT | INPUT_TRANSFORM_Y_INVERT)>;

    scroll_layer_3 {
        layers = <3>;
        input-processors = <&zip_xy_transform (INPUT_TRANSFORM_X_INVERT)>, <&zip_scroll_x_only_mapper>;
    };

    scroll_layer_4 {
        layers = <4>;
        input-processors = <&zip_scroll_y_only_mapper>;
    };
};